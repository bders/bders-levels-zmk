
&trackball_central_listener {
    status = "okay";
    device = <&trackball_central>;

    mouse_layer {
        layers = <1>;
        input-processors
        = <&zip_xy_transform (INPUT_TRANSFORM_Y_INVERT | INPUT_TRANSFORM_X_INVERT | INPUT_TRANSFORM_XY_SWAP)>
        , <&zip_xy_scaler 1 1>
        ;
    };
};

&trackball_peripheral_split_listener {
    status = "okay";
    device = <&trackball_peripheral>;  /* if your split device is &trackball_peripheral_split, use that */
    /delete-property/ input-processors;

    mouse_layer {
        layers = <1>;
        input-processors = <&zip_ble_report_rate_limit>;
    };
};
