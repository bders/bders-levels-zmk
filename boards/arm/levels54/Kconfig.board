## boards/arm/levels54/Kconfig.board
```kconfig
# SPDX-License-Identifier: MIT

config BOARD_LEVELS54_LEFT
  bool "levels54_right"
  depends on SOC_NRF52840_QIAA

config BOARD_LEVELS54_RIGHT
  bool "levels54_right"
  depends on SOC_NRF52840_QIAA
```

## boards/arm/levels54/Kconfig.defconfig
```kconfig
# SPDX-License-Identifier: MIT

if BOARD_LEVELS54_LEFT

config ZMK_KEYBOARD_NAME
  default "Levels54"

config BOARD
  default "levels54_left"

config ZMK_SPLIT_ROLE_CENTRAL
  default y

endif # BOARD_LEVELS54_LEFT

if BOARD_LEVELS54_RIGHT

config BOARD
  default "levels54_right"

endif # BOARD_LEVELS54_RIGHT

if BOARD_LEVELS54_LEFT || BOARD_LEVELS54_RIGHT

config ZMK_STUDIO_LOCKING
  default n

config ZMK_SPLIT
  default y

config BT_CTLR
  default BT

config PINCTRL
  default y

if USB

config USB_NRFX
  default y

config USB_DEVICE_STACK
  default y

endif # USB

config SPI
  default y

endif # BOARD_LEVELS54_LEFT ||  BOARD_LEVELS54_RIGHT
```
