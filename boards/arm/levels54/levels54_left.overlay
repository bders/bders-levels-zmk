/* Central sensor on the left half */
&trackball_central_listener {
    status = "okay";
    device = <&trackball_central>;     /* or <&pmw3610> if that is your label */
    /delete-property/ input-processors; /* ensure no always-on processors */

    mouse_layer {
        layers = <1>;
        input-processors = <&zip_ble_report_rate_limit>;
    };
};

/* Events coming from the split peripheral into the central half */
&trackball_peripheral_split_listener {
    status = "okay";
    device = <&trackball_peripheral>;  /* if your split device is &trackball_peripheral_split, use that */
    /delete-property/ input-processors;

    mouse_layer {
        layers = <1>;
        input-processors = <&zip_ble_report_rate_limit>;
    };
};
